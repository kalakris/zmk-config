## vendor/zmk-raw-touch/Kconfig
```kconfig
# Copyright (c) 2026 Mrinal Kalakrishnan
# SPDX-License-Identifier: MIT

menu "Raw touch frames"

config ZMK_RAW_TOUCH
    bool "Stream raw absolute touch frames over a vendor HID report"
    default y
    depends on DT_HAS_ZMK_RAW_TOUCH_PAD_ENABLED
    depends on ZMK_POINTING
    # The feature report publishes the SoC's hwinfo device id, so a host
    # can recognize one keyboard across USB and Bluetooth. Without a
    # HWINFO driver the field is simply reported as unknown, but the call
    # has to link.
    select HWINFO
    help
      Stream absolute touch frames (position + touch strength) from a
      trackpad running in absolute mode to the host over a vendor-defined
      HID report on its own HID interface / HIDS instance, so no fork of
      ZMK core is required.

      Relative deltas derived from successive frames are always re-injected
      into the pad's normal input listener chain as well, so ordinary
      pointing (and any keymap wheel-mapping overlays) keep working with
      no host software at all (Standard mode). Frames are only emitted
      while a host holds a lease on them (RawTouch mode).

      Configure pads with zmk,raw-touch-pad devicetree nodes.

if ZMK_RAW_TOUCH

config ZMK_RAW_TOUCH_USB
    bool "Send raw touch frames over USB"
    default y
    depends on ZMK_USB
    # Only the central half talks to the host. The core ZMK_RAW_TOUCH symbol
    # needs no such dependency: the pad nodes that enable it belong on the
    # central, and a build with no transport at all still links against a
    # no-op send (src/raw_touch_endpoints.c) and keeps Standard mode.
    depends on !ZMK_SPLIT || ZMK_SPLIT_ROLE_CENTRAL
    help
      Registers a SECOND USB HID interface (HID_1) carrying only the raw
      touch report. Requires CONFIG_USB_HID_DEVICE_COUNT >= 2.

config ZMK_RAW_TOUCH_USB_QUEUE_SIZE
    int "Max number of raw touch reports to queue for sending over USB"
    default 4
    range 2 255
    depends on ZMK_RAW_TOUCH_USB
    help
      Frames waiting for the interrupt IN endpoint.

      The endpoint carries one transfer at a time and the queue is drained
      by transfer completion, so it only has to cover what can pile up
      within one host poll interval: the other pad sampling at the same
      moment, or a peripheral pad's frames arriving from the split link in
      a burst. 4 covers both with room to spare. A deeper queue would only
      add latency - a frame the host receives late is worth less than the
      fresh one behind it.

      When the queue is full the oldest MOTION frame is evicted; release
      frames (touched = 0) are never evicted, because losing one leaves the
      host holding a finger-down until its silence watchdog fires. If no
      entry can be evicted, the incoming frame is dropped - even a release
      - and the log warns that the queue is full of undelivered release
      frames. Raise this if you see that warning: it means more pads than
      the queue can hold.

config ZMK_RAW_TOUCH_BLE
    bool "Send raw touch frames over BLE"
    default y
    depends on ZMK_BLE
    depends on !ZMK_SPLIT || ZMK_SPLIT_ROLE_CENTRAL
    help
      Registers a SECOND HID-over-GATT (HIDS) service instance carrying
      only the raw touch report.

      NOTE: host support for two HIDS instances on one peripheral is not
      universal. If your host ignores the second service, disable this and
      use USB for the raw frames; Standard mode still works over BLE.

config ZMK_RAW_TOUCH_BLE_QUEUE_SIZE
    int "Max number of raw touch reports to queue for sending over BLE"
    default 8
    range 2 255
    depends on ZMK_RAW_TOUCH_BLE
    help
      Frames waiting for a BLE connection event.

      Sized to cover arrival batching, not to buffer a backlog. Frames are
      ~10 ms apart and a host collects them in bursts about one connection
      interval wide (~15 ms on macOS), so 8 frames is ~80 ms of slack -
      several intervals' worth. A frame older than that is useless for
      scrolling: the host reconstructs motion from the device timestamps in
      the frames it does get, and a stale position only delays the fresh
      one behind it.

      When the queue is full the oldest MOTION frame is evicted; release
      frames (touched = 0) are never evicted and are retried on a transient
      notify error. If no entry can be evicted, the incoming frame is
      dropped - even a release, which leaves the host holding a
      finger-down until its silence watchdog fires - and the log warns
      that the queue is full of undelivered release frames. A smaller
      queue makes that more likely. Raise this if you see that warning: it
      means more pads than the queue can hold.

config ZMK_RAW_TOUCH_BLE_THREAD_STACK_SIZE
    int "Stack size of the BLE send work queue"
    default ZMK_BLE_THREAD_STACK_SIZE
    depends on ZMK_RAW_TOUCH_BLE
    help
      The module runs its own work queue for BLE notifications so that a
      frame burst can never delay ZMK's own HID reports.

endif # ZMK_RAW_TOUCH

config ZMK_INPUT_PROCESSOR_RAW_TOUCH_SCROLL
    bool "Raw touch scroll-context marker input processor"
    default y
    depends on DT_HAS_ZMK_INPUT_PROCESSOR_RAW_TOUCH_SCROLL_ENABLED
    depends on ZMK_POINTING
    help
      A pass-through processor whose presence in the chain handling a
      pad's events marks those frames as scroll context (frame flags
      bit 1). Place it first in the chain.

config ZMK_INPUT_PROCESSOR_RAW_TOUCH_IDLE_FILTER
    bool "Raw touch idle-sync filter input processor"
    default y
    depends on DT_HAS_ZMK_INPUT_PROCESSOR_RAW_TOUCH_IDLE_FILTER_ENABLED
    depends on ZMK_POINTING
    help
      Drops sync events that accumulated no host-visible change, so an
      absolute-mode pad streaming at ~100 Hz does not also emit ~100 Hz
      all-zero mouse HID reports (which on BLE compete with the raw
      frames for connection events).

config ZMK_INPUT_PROCESSOR_RAW_TOUCH_SPLIT_STAMP
    bool "Peripheral sample-time stamp for relayed raw touch pads"
    default y
    depends on DT_HAS_ZMK_INPUT_PROCESSOR_RAW_TOUCH_SPLIT_STAMP_ENABLED
    # Peripheral-only: it reports through the split link's peripheral API,
    # which does not exist on the central. The central side needs nothing
    # enabled - raw_touch.c always understands the stamp.
    depends on ZMK_INPUT_SPLIT && !ZMK_SPLIT_ROLE_CENTRAL
    help
      Chained on a split peripheral's zmk,input-split relay, sends the
      peripheral's own sample time along with every absolute frame, so a
      relayed pad's frame timestamps stop carrying the split link's
      delivery jitter (up to one poll cycle on a polled wired link).

module = ZMK_RAW_TOUCH
module-str = ZMK_RAW_TOUCH
source "${ZEPHYR_BASE}/subsys/logging/Kconfig.template.log_config"

endmenu

# The raw touch report needs a second USB HID interface alongside ZMK's.
# Module Kconfig is sourced before Zephyr's subsys/, so this default takes
# precedence over the subsystem's own default of 1; an application .conf
# that pins the symbol lower still wins, which raw_touch_usb_hid.c
# BUILD_ASSERTs against.
config USB_HID_DEVICE_COUNT
    default 2 if ZMK_RAW_TOUCH_USB
```

## vendor/zmk-raw-touch/dts/bindings/input/zmk,raw-touch-pad.yaml
```yaml
# Copyright (c) 2026 Mrinal Kalakrishnan
# SPDX-License-Identifier: MIT

description: |
  A trackpad whose absolute touch frames are streamed to the host over the
  raw touch vendor HID report.

  The referenced input device must emit INPUT_ABS_X, INPUT_ABS_Y and
  INPUT_ABS_Z (the last carrying the sync flag) - i.e. it must be running
  in absolute mode. The module is otherwise driver-agnostic: nothing here
  is specific to any particular touchpad ASIC.

  Geometry and orientation are declared here rather than read from the
  driver's own devicetree properties, both so the module does not depend
  on a specific driver binding and so the values can be published verbatim
  in the self-describing feature report.

compatible: "zmk,raw-touch-pad"

properties:
  device:
    type: phandle
    required: true
    description: The input device producing absolute touch events.

  pad-id:
    type: int
    default: 0
    description: |
      Identifies this pad in streamed frames (byte 0) and sets the pad's
      bit in the feature report's pads-present bitmask. Must be unique and
      less than 8.

  x-max:
    type: int
    default: 2047
    description: |
      Maximum absolute X coordinate the pad reports. The default is the
      Cirque Pinnacle full-scale value.

  y-max:
    type: int
    default: 1535
    description: |
      Maximum absolute Y coordinate the pad reports. The default is the
      Cirque Pinnacle full-scale value.

  resolution:
    type: int
    default: 38
    description: |
      Pad resolution in counts per millimetre, 0 if unknown. The default is
      the Cirque Pinnacle value.

  rotate-90:
    type: boolean
    description: |
      The pad is physically mounted rotated 90 degrees. Streamed frames are
      NOT transformed - the raw coordinates go out as-is and this flag is
      published in the feature report's orientation byte so the host can
      apply it. It IS applied to the relative deltas this module derives
      for the Standard-mode pointer path.

  x-invert:
    type: boolean
    description: As rotate-90, for the X axis.

  y-invert:
    type: boolean
    description: As rotate-90, for the Y axis.

  tap-click:
    type: boolean
    description: |
      Detect taps in firmware and inject an INPUT_BTN_0 press+release into
      this pad's input listener chain. Absolute mode usually disables a
      pad's hardware tap-to-click, so this is its replacement.

      The pad's listener chain must NOT contain a processor that consumes
      INPUT_BTN_0 (e.g. zmk,input-processor-behaviors mapping it to &none),
      or the injected click is swallowed.

  tap-click-while-scrolling:
    type: boolean
    description: |
      Also report taps for touches that were handled by a processor chain
      marked with zmk,input-processor-raw-touch-scroll. Without this, a
      touch that entered scroll context never produces a tap, which keeps
      a flick on a scroll layer from clicking. Set it on a dedicated
      scrolling pad whose taps should still click - for example, mapped to
      a right click by the listener chain, as MoErgo's stock Go60 keymap
      does with its left pad. Requires tap-click.

      In Standard mode the tap is emitted at lift-off as usual. While a
      host holds the lease, the firmware cannot tell such a tap from a
      short touch that merely stopped the host's momentum, so it parks the
      tap for a moment and emits it only when the host confirms it (a
      feature-report command; RawTouch does this automatically for touches
      that did not catch a coast). The listener chain decides what the tap
      does in both cases. The pad advertises this in its feature-report
      slot so a host knows to confirm.

  tap-max-ms:
    type: int
    default: 180
    description: Maximum touch duration still counted as a tap.

  tap-max-movement:
    type: int
    default: 30
    description: |
      Maximum Chebyshev distance in raw counts a touch may stray from its
      touch-down point and still count as a tap.
```

## vendor/zmk-raw-touch/dts/bindings/input_processors/zmk,input-processor-raw-touch-idle-filter.yaml
```yaml
# Copyright (c) 2026 The ZMK Contributors
# SPDX-License-Identifier: MIT

description: |
  Drops sync events that accumulated no host-visible change.

  An input listener sends a mouse HID report on every sync event, even one
  that carries no motion, no scroll and no button transition - a
  host-invisible no-op that still costs a USB transfer or a BLE
  notification. A pad streaming absolute frames at ~100 Hz produces one
  such sync per frame (absolute events contribute nothing to a mouse
  report), and a downscaling wheel overlay adds more by emitting value-0
  relative events. On BLE these compete with the raw stream's own
  notifications for connection events.

  Place it LAST in the chain, after every scaler, mapper and temp-layer
  processor, so it sees final values and does not starve them of events.

  Each devicetree node carries one instance of the "has anything been
  accumulated since the last sync" flag. Referencing the same node from a
  listener's base chain and from its layer overlays is fine - only one of
  those chains handles any given event, and a sync group does not
  normally straddle a layer change. Referencing it from two DIFFERENT
  listeners is not: their event streams interleave and would corrupt each
  other's flag. Declare a second node for a second pad.

compatible: "zmk,input-processor-raw-touch-idle-filter"

include: ip_zero_param.yaml
```

## vendor/zmk-raw-touch/dts/bindings/input_processors/zmk,input-processor-raw-touch-scroll.yaml
```yaml
# Copyright (c) 2026 The ZMK Contributors
# SPDX-License-Identifier: MIT

description: |
  Marker input processor for raw touch streaming.

  Passes every event through unchanged. Its only effect is to mark a
  "scroll context": while this processor is reached by events from a
  zmk,raw-touch-pad's input device, that pad's streamed frames carry the
  scroll-mode flag, and a host consuming the stream can synthesize
  gesture-phase scrolling instead of pointer motion.

  Because the marker only runs when the chain containing it is the one
  actually handling the pad's events, layer-overlay ordering and
  process-next shadowing are honoured for free.

  Place it FIRST in the chain, before any processor that might consume or
  rewrite events.

compatible: "zmk,input-processor-raw-touch-scroll"

include: ip_zero_param.yaml
```

## vendor/zmk-raw-touch/dts/bindings/input_processors/zmk,input-processor-raw-touch-split-stamp.yaml
```yaml
# Copyright (c) 2026 Mrinal Kalakrishnan
# SPDX-License-Identifier: MIT

description: |
  Stamps a relayed pad's frames with the peripheral's sample time.

  For a pad on a split peripheral, the module's frame handler runs on the
  central and would otherwise timestamp each frame when it gets there -
  after the split hop, which on a polled wired link adds up to one poll
  cycle of jitter to the timestamp hosts derive velocity from.

  Chain this processor on the PERIPHERAL half's zmk,input-split relay
  node (the one whose `device` is the pad). On the sync event of every
  absolute frame it sends one extra input event through the relay ahead
  of that sync, carrying the peripheral's clock; the central's frame
  handler uses it in place of its own. Nothing is needed on the central,
  and the wire protocol is unchanged - the timestamp just gets better.

  The one cell parameter is the relay's `reg` (the unit address of the
  zmk,input-split node, e.g. 0 for `trackpad_split@0`): the central
  routes relayed events to its matching relay node by that address, so
  the stamp must carry the same one as the frames it belongs to. It is a
  cell rather than a phandle property so the relay -> processor ->
  relay reference does not form a devicetree dependency cycle.

  The processor is built only on a split peripheral; declare its node in
  the peripheral's overlay:

    zip_raw_touch_split_stamp: zip_raw_touch_split_stamp {
        compatible = "zmk,input-processor-raw-touch-split-stamp";
        #input-processor-cells = <1>;
    };

    &trackpad_split {
        input-processors = <&zip_raw_touch_split_stamp 0>;
    };

compatible: "zmk,input-processor-raw-touch-split-stamp"

include: ip_one_param.yaml
```
